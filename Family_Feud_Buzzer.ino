/* --------------------------------------
 *  Highlands Latin School - House System
 *  Family Feud Game
 *  May 2021
 *  Version 1.0
 *  Microcontroller Code and Wiring:      Tony Hernandez
 *  3-D Printed Objects:                  Michael LePrell
 *  Family Feud Interactive Console Game: August Rothpletz
 *  Questions and Data:                   Dr. Suer and Senior Calculus Class
 */


/* ---- Global Variables ---- */
int P1Light = 3;    //Player 1 light
int P1 = 5;         //P1 Button Pin
int P1Buzz;      //Store high/low trigger
int P2Light = 4;    //Player 2 light
int P2 = 6;         //P2 Button Pin
int P2Buzz;      //Store high/low trigger
int resetPlayer = 2;//Reset Player Buzz-In
int resetPlayerVal;    //To read high/low trigger
bool isBuzzed;      //When pressed, to block other player light

int S1 = A1;        //Strike 1 Light
int S2 = A2;        //Strike 2 Light
int S3 = A3;        //Strike 3 Light
int strikePin = A4; //Cycle strikes
int strikes;        //Number of strikes
int strikePinVal;   //Read high/low trigger
int timeSinceStrike;

int timeStrike;     //time of previous strike (debounce)
int timePlayerReset;//time of previous player reset (debounce)

/* -- Included Sound Clips -- */
//http://highlowtech.org/?p=1963
#include <PCM.h>
const unsigned char buzzSound[]  PROGMEM = {
129, 128, 127, 127, 127, 127, 128, 128, 127, 127, 128, 128,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 128, 
};
const unsigned char strikeSound[] PROGMEM = {
129, 129, 128, 127, 129, 129, 128, 126, 125, 127, 128, 128,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 127, 
};


/* --------- Functions --------- */
void buzzIn(int player)
{  
  
  if (player == P1 && isBuzzed == false)
  {
    isBuzzed = true;
    digitalWrite(P1Light, HIGH);
    startPlayback(buzzSound, sizeof(buzzSound));
  }
  else if(player == P2 && isBuzzed == false)
  {
    isBuzzed = true;
    digitalWrite(P2Light, HIGH);
    startPlayback(buzzSound, sizeof(buzzSound));
  }
}

void resetBuzzer()
{
  digitalWrite(P1Light, LOW);
  digitalWrite(P2Light, LOW);
  isBuzzed = false; 
}

void strike()
{
  strikes = (strikes + 1) % 4;
  if (strikes > 0)
      startPlayback(strikeSound, sizeof(strikeSound));
  if (0 == strikes)
  {
    digitalWrite(S1, LOW);
    digitalWrite(S2, LOW);
    digitalWrite(S3, LOW);
  }
  if (strikes > 0)
  {
    //call strike sound
    digitalWrite(S1, HIGH);
  }
  if (strikes > 1)
  {
    //call strike sound
    digitalWrite(S2, HIGH);
  }
  if (strikes > 2)
  {
    //call strike sound
    digitalWrite(S3, HIGH);
  }
  //Serial.print("End strike. Millis() = ");
  //Serial.println(millis());
}


/* ---- Initialize Variables ---- */
void setup() {
  Serial.begin(9600);

  isBuzzed = false;
  P1Buzz = 0;
  P2Buzz = 0;  
  pinMode(P1Light, OUTPUT); //Player 1 lights
  pinMode(P2Light, OUTPUT); //Player 2 lights
  pinMode(P1, INPUT_PULLUP);//Player 1 button
  pinMode(P2, INPUT_PULLUP);//Player 2 button
  pinMode(resetPlayer, INPUT_PULLUP); //Button: Reset Player. Initialize HIGH

  pinMode(S1, OUTPUT); //First Strike
  pinMode(S2, OUTPUT); //Second Strike
  pinMode(S3, OUTPUT); //Third Strike
  pinMode(strikePin, INPUT_PULLUP); //Button: Cycle Strikes

  pinMode(2, OUTPUT); //White LED

  digitalWrite(S1, LOW);
  digitalWrite(S2, LOW);
  digitalWrite(S3, LOW);
  digitalWrite(P1Light, LOW);
  digitalWrite(P2Light, LOW);  

  timeStrike = 0;
  timeSinceStrike = 0;
  timePlayerReset = 0;
}


/* ---- Main Program Loop ---- */
void loop() {

  //Check Player Buzz-In
  P1Buzz = digitalRead(P1);
  P2Buzz = digitalRead(P2);
  if(LOW == P1Buzz)
  {
    buzzIn(P1);
  }
  else if (LOW == P2Buzz)
  {
    buzzIn(P2);
  }

  //Check Reset-Player Button
  resetPlayerVal = digitalRead(resetPlayer);
  if (LOW == resetPlayerVal)
  {
    resetBuzzer();
  }

  //Check Strike Button
  strikePinVal = digitalRead(strikePin);
  //Count time since previous strike for debounce
  timeSinceStrike = (millis()-timeStrike);
  //Hold Button for 1 program cycle to engage
  if (strikePinVal == LOW && timeSinceStrike>1000)
  {
    timeStrike = millis();
    Serial.print("Time strike is ");
    Serial.println(timeStrike);
    strike();   //Cycle through strikes
    
  }
}
